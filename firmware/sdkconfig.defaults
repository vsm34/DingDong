## firmware/sdkconfig.defaults
```kconfig
CONFIG_PARTITION_TABLE_SINGLE_APP_LARGE=y
CONFIG_ESP_MAIN_TASK_STACK_SIZE=8192
CONFIG_FREERTOS_HZ=1000
CONFIG_MBEDTLS_HMAC_DRBG_ENABLED=y
CONFIG_ESP_HTTP_SERVER_MAX_OPEN_SOCKETS=7
CONFIG_HTTPD_MAX_REQ_HDR_LEN=1024
CONFIG_FATFS_LFN_HEAP=y
CONFIG_CAMERA_TASK_STACK_SIZE=8192
CONFIG_ESP_TLS_INSECURE=n
CONFIG_ESP_TLS_SKIP_SERVER_CERT_VERIFY=n
CONFIG_SPIRAM=y
CONFIG_SPIRAM_MODE_OCT=y
CONFIG_SPIRAM_SPEED_80M=y
CONFIG_SPIRAM_USE_MALLOC=y
CONFIG_SPIRAM_MALLOC_ALWAYSINTERNAL=16384
CONFIG_ESP32S3_DATA_CACHE_SIZE_64KB=y
```
